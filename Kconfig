## west.yml
```yaml
# 
# Copyright (c) 2026 Ahmed Azeem. All rights reserved.
# 
# NOTICE: This file is part of a private developer preview. 
# All information contained herein is, and remains the property of 
# Ahmed Azeem. Dissemination of this information or 
# reproduction of this material is strictly forbidden unless prior 
# written permission is obtained.
# 
manifest:
  remotes:
  # Trusted Firmware M remote
    - name: tf-m-remote
      url-base: https://github.com/TrustedFirmware-M

  projects:
    - name: trusted-firmware-m
      remote: tf-m-remote
      revision: TF-Mv2.3.0-RC1
      path: modules/spe/tf-m
      groups:
        - spe

  self:
    path: coleus
```
